## config/west.yml
```yaml
manifest:
  defaults:
    revision: v0.3.0

  remotes:
    - name: urob
      url-base: https://github.com/urob
    - name: zmkfirmware
      url-base: https://github.com/zmkfirmware

  projects:
    - name: zmk
      remote: zmkfirmware
      import: app/west.yml

    - name: zmk-helpers
      remote: urob
      path: modules/zmk/helpers

  self:
    path: config
```

## src/zmk/config/west.yml
```yaml
manifest:
  defaults:
    revision: v0.3.0

  remotes:
    - name: urob
      url-base: https://github.com/urob
    - name: zmkfirmware
      url-base: https://github.com/zmkfirmware

  projects:
    - name: zmk
      remote: zmkfirmware
      import: app/west.yml

    - name: zmk-helpers
      remote: urob
      path: modules/zmk/helpers

    - name: mechboards-corne-min
      url: https://github.com/MechboardsLTD/zmk-module
      revision: corne-min
      path: modules/vendor/mechboards/corne-min

    - name: mechboards-corne-min-rgbled
      url: https://github.com/MechboardsLTD/zmk-module
      revision: corne-min-rgbled
      path: modules/vendor/mechboards/corne-min-rgbled

  self:
    path: config
```

#include <behaviors.dtsi>
#include <dt-bindings/zmk/keys.h>
#include <dt-bindings/zmk/bt.h>
#include <dt-bindings/zmk/pointing.h>
#include "zmk-helpers/helper.h"

// Layer names
#define FOCAL 0
#define NAV 1
#define NUM 2
#define SYM 3

// Defaults
#define QUICK_TAP_MS 175

// Home row mods (stolen from urob)
// NOTE(mt): Can remove these 3 #defines after upgrading zmk-helpers.
#define KEYS_L LT0 LT1 LT2 LT3 LT4 LM0 LM1 LM2 LM3 LM4 LB0 LB1 LB2 LB3 LB4
#define KEYS_R RT0 RT1 RT2 RT3 RT4 RM0 RM1 RM2 RM3 RM4 RB0 RB1 RB2 RB3 RB4
#define THUMBS LH1 LH0 RH0 RH1

#define MAKE_HRM(NAME, HOLD, TAP, TRIGGER_POS)                                 \
  ZMK_HOLD_TAP(NAME, bindings = <HOLD>, <TAP>; flavor = "balanced";            \
               tapping-term-ms = <280>; quick-tap-ms = <QUICK_TAP_MS>;         \
               require-prior-idle-ms = <150>; hold-trigger-on-release;         \
               hold-trigger-key-positions = <TRIGGER_POS>;)

MAKE_HRM(hml, &kp, &kp, KEYS_R THUMBS)
MAKE_HRM(hmr, &kp, &kp, KEYS_L THUMBS)

// Combos
#define COMBO_TERM_FAST 18
#define COMBO_TERM_SLOW 30
#define COMBO_IDLE_FAST 150
#define COMBO_IDLE_SLOW 50

#define ZMK_COMBO_8(NAME, TAP, POS, LAYERS, COMBO_MS, IDLE_MS, HOLD, SIDE)     \
  MAKE_HRM(hm_combo_##NAME, &kp, TAP, SIDE THUMBS)                             \
  ZMK_COMBO_6(NAME, &hm_combo_##NAME HOLD 0, POS, LAYERS, COMBO_MS, IDLE_MS)

// Horizontal combos - left hand
ZMK_COMBO(colon,     &kp COLON,           LT2 LT1, FOCAL, COMBO_TERM_FAST, COMBO_IDLE_FAST)
ZMK_COMBO(esc,       &hml LG(LSHFT) ESC,  LM2 LM1, FOCAL, COMBO_TERM_FAST, COMBO_IDLE_FAST)
ZMK_COMBO(copy,      &kp LG(C),           LB3 LB2, FOCAL, COMBO_TERM_FAST, COMBO_IDLE_FAST)
ZMK_COMBO(paste,     &kp LG(V),           LB2 LB1, FOCAL, COMBO_TERM_FAST, COMBO_IDLE_FAST)
ZMK_COMBO(cut,       &kp LG(X),           LB3 LB1, FOCAL, COMBO_TERM_FAST, COMBO_IDLE_FAST)

// Horizontal combos - right hand
ZMK_COMBO(bspc,      &kp BSPC,            RT1 RT2, FOCAL, COMBO_TERM_FAST, COMBO_IDLE_FAST)
ZMK_COMBO(del,       &kp DEL,             RT2 RT3, FOCAL, COMBO_TERM_FAST, COMBO_IDLE_FAST)
ZMK_COMBO(lpar,      &lpar_morph,         RM1 RM2, FOCAL, COMBO_TERM_FAST, COMBO_IDLE_FAST, LG(LSHFT), KEYS_L)
ZMK_COMBO(rpar,      &rpar_morph,         RM2 RM3, FOCAL, COMBO_TERM_FAST, COMBO_IDLE_FAST, LG(LALT), KEYS_L)
ZMK_COMBO(lbkt,      &kp LBKT,            RB1 RB2, FOCAL, COMBO_TERM_FAST, COMBO_IDLE_FAST)
ZMK_COMBO(rbkt,      &kp RBKT,            RB2 RB3, FOCAL, COMBO_TERM_FAST, COMBO_IDLE_FAST)

// Morphs
ZMK_MOD_MORPH(lpar_morph, mods = <MOD_LSFT>; bindings = <&kp LPAR>, <&kp LT>;)
ZMK_MOD_MORPH(rpar_morph, mods = <MOD_LSFT>; bindings = <&kp RPAR>, <&kp GT>;)

// Define shorter / mnemonic names
#define U_BRI_DN F14
#define U_BRI_UP F15

// Keymap
ZMK_BASE_LAYER(Focal,
//╭─────────────┬─────────────┬─────────────┬─────────────┬─────────────╮   ╭─────────────┬─────────────┬─────────────┬─────────────┬─────────────╮
//│             │             │             │             │             │   │             │             │             │             │             │
    &kp V         &kp L         &kp H         &kp G         &kp K       ,     &kp Q         &kp F         &kp O         &kp U         &kp J       ,
//├─────────────┼─────────────┼─────────────┼─────────────┼─────────────┤   ├─────────────┼─────────────┼─────────────┼─────────────┼─────────────┤
//│             │             │             │             │             │   │             │             │             │             │             │
    &hml LCTRL S  &hml LALT R   &hml LGUI N   &hml LSHFT T  &kp B       ,     &kp Y         &hmr RSHFT C  &hmr RGUI A   &hmr RALT E   &hmr RCTRL I,
//├─────────────┼─────────────┼─────────────┼─────────────┼─────────────┤   ├─────────────┼─────────────┼─────────────┼─────────────┼─────────────┤
//│             │             │             │             │             │   │             │             │             │             │             │
    &kp Z         &kp X         &kp M         &kp D         &kp P       ,     &kp SQT       &kp W         &kp COMMA     &kp DOT       &kp FSLH    ,
//╰─────────────┴─────────────┴─────────────┼─────────────┼─────────────┤   ├─────────────┼─────────────┼─────────────┴─────────────┴─────────────╯
//                                          │             │             │   │             │             │
                                              &lt NAV SPACE &kp TAB      ,    &lt SYM ENTER &lt NUM BSPC
//                                          ╰─────────────┴─────────────╯   ╰─────────────┴─────────────╯
)

ZMK_OTHER_LAYER(Nav,
//╭─────────────┬─────────────┬─────────────┬─────────────┬─────────────╮   ╭─────────────┬─────────────┬─────────────┬─────────────┬─────────────╮
//│             │             │             │             │             │   │             │             │             │             │             │
    &none         &none         &none         &bt BT_CLR    &none       ,     &none         &none         &kp U_BRI_DN  &kp U_BRI_UP  &none       ,
//├─────────────┼─────────────┼─────────────┼─────────────┼─────────────┤   ├─────────────┼─────────────┼─────────────┼─────────────┼─────────────┤
//│             │             │             │             │             │   │             │             │             │             │             │
    &kp LCTRL     &kp LALT      &kp LGUI      &kp LSHFT     &none       ,     &caps_word    &kp LEFT      &kp DOWN      &kp UP        &kp RIGHT   ,
//├─────────────┼─────────────┼─────────────┼─────────────┼─────────────┤   ├─────────────┼─────────────┼─────────────┼─────────────┼─────────────┤
//│             │             │             │             │             │   │             │             │             │             │             │
    &none         &bt BT_SEL 0  &bt BT_SEL 1  &bt BT_SEL 2  &none       ,     &none         &none         &kp C_VOL_DN  &kp C_VOL_UP  &none       ,
//╰─────────────┴─────────────┴─────────────┼─────────────┼─────────────┤   ├─────────────┼─────────────┼─────────────┴─────────────┴─────────────╯
//                                          │             │             │   │             │             │
                                              &none         &none       ,     &none         &none
//                                          ╰─────────────┴─────────────╯   ╰─────────────┴─────────────╯
)

ZMK_OTHER_LAYER(Num,
//╭─────────────┬─────────────┬─────────────┬─────────────┬─────────────╮   ╭─────────────┬─────────────┬─────────────┬─────────────┬─────────────╮
//│             │             │             │             │             │   │             │             │             │             │             │
    &kp LBKT      &kp N7        &kp N8        &kp N9        &kp RBKT    ,     &none         &none         &none         &none         &none       ,
//├─────────────┼─────────────┼─────────────┼─────────────┼─────────────┤   ├─────────────┼─────────────┼─────────────┼─────────────┼─────────────┤
//│             │             │             │             │             │   │             │             │             │             │             │
    &kp SEMI      &kp N4        &kp N5        &kp N6        &kp EQUAL   ,     &none         &kp RSHFT     &kp RGUI      &kp RALT      &kp RCTRL   ,
//├─────────────┼─────────────┼─────────────┼─────────────┼─────────────┤   ├─────────────┼─────────────┼─────────────┼─────────────┼─────────────┤
//│             │             │             │             │             │   │             │             │             │             │             │
    &kp GRAVE     &kp N1        &kp N2        &kp N3        &kp BSLH    ,     &none         &none         &none         &none         &none       ,
//╰─────────────┴─────────────┴─────────────┼─────────────┼─────────────┤   ├─────────────┼─────────────┼─────────────┴─────────────┴─────────────╯
//                                          │             │             │   │             │             │
                                              &kp N0        &kp MINUS   ,     &none         &none
//                                          ╰─────────────┴─────────────╯   ╰─────────────┴─────────────╯
)

ZMK_OTHER_LAYER(Sym,
//╭─────────────┬─────────────┬─────────────┬─────────────┬─────────────╮   ╭─────────────┬─────────────┬─────────────┬─────────────┬─────────────╮
//│             │             │             │             │             │   │             │             │             │             │             │
    &kp LBRC      &kp AMPS      &kp ASTRK     &kp LPAR      &kp RBRC    ,     &none         &none         &none         &none         &none       ,
//├─────────────┼─────────────┼─────────────┼─────────────┼─────────────┤   ├─────────────┼─────────────┼─────────────┼─────────────┼─────────────┤
//│             │             │             │             │             │   │             │             │             │             │             │
    &kp COLON     &kp DLLR      &kp PRCNT     &kp CARET     &kp PLUS    ,     &none         &kp RSHFT     &kp RGUI      &kp RALT      &kp RCTRL   ,
//├─────────────┼─────────────┼─────────────┼─────────────┼─────────────┤   ├─────────────┼─────────────┼─────────────┼─────────────┼─────────────┤
//│             │             │             │             │             │   │             │             │             │             │             │
    &kp TILDE     &kp EXCL      &kp AT        &kp HASH      &kp PIPE    ,     &none         &none         &none         &none         &none       ,
//╰─────────────┴─────────────┴─────────────┼─────────────┼─────────────┤   ├─────────────┼─────────────┼─────────────┴─────────────┴─────────────╯
//                                          │             │             │   │             │             │
                                              &kp RPAR      &kp UNDER   ,     &none         &none
//                                          ╰─────────────┴─────────────╯   ╰─────────────┴─────────────╯
)

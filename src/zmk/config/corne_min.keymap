#define ZMK_BASE_LAYER(name, LT, RT, LM, RM, LB, RB, LH, RH) \
    ZMK_LAYER(                                               \
        name,                                                \
        &none LT RT &none                                    \
        &none LM RM &none                                    \
        &none LB RB &none                                    \
        &none LH RH &kp DEL                                  \
    )

#define ZMK_OTHER_LAYER(name, LT, RT, LM, RM, LB, RB, LH, RH) \
    ZMK_LAYER(                                               \
        name,                                                \
        &none LT RT &none                                    \
        &none LM RM &none                                    \
        &none LB RB &none                                    \
        &none LH RH &none                                    \
    )

#include "zmk-helpers/key-labels/42.h"
#include "common.dtsi"
